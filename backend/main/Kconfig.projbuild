## backend/main/Kconfig.projbuild
```kconfig
menu "Wekker-Radio Configuratie"

    menu "WiFi"
        comment "WiFi credentials worden opgeslagen via de captive portal (NVS)."
        comment "Bij eerste opstart verschijnt een SoftAP 'wekker-XXXXXX' om in te stellen."

        config DEVICE_HOSTNAME
            string "Hostname"
            default "patnic-wekker-radio"
            help
                Naam waaronder het apparaat zich registreert bij de DHCP-server.
                Zichtbaar in de apparatenlijst van de router.

        config SOFTAP_SSID
            string "SoftAP naam (SSID)"
            default "patnic-wekker-radio"
            help
                Naam van het WiFi-accesspoint bij eerste configuratie.
                De laatste 3 bytes van het MAC-adres worden automatisch toegevoegd.
    endmenu

    menu "UART Besturing"
        config UART_BAUDRATE
            int "Baudrate"
            default 460800
            help
                Baudrate voor UART2 communicatie met de frontend.
                Beide apparaten moeten dezelfde waarde gebruiken.

        config UART_RX_PIN
            int "LyraT UART RX GPIO (ontvangt van Frontend)"
            default 15
            help
                GPIO waarop de LyraT commando's ontvangt (verbonden met TX van de test ESP32).

        config UART_TX_PIN
            int "LyraT UART TX GPIO (stuurt naar Frontend)"
            default 13
            help
                GPIO waarop de LyraT antwoorden stuurt (verbonden met RX van de test ESP32).
    endmenu

    menu "Weer (Open-Meteo)"
        config WEATHER_LATITUDE
            string "Breedtegraad"
            default "51.6417"
            help
                Breedtegraad van de locatie (decimaal, bijv. 51.6417 voor Oosterhout).

        config WEATHER_LONGITUDE
            string "Lengtegraad"
            default "4.8611"
            help
                Lengtegraad van de locatie (decimaal, bijv. 4.8611 voor Oosterhout).
    endmenu

    menu "Audio"
        config AUDIO_VOLUME
            int "Standaard volume (0-100)"
            default 10
            range 0 100

        config AUDIO_SAMPLE_RATE
            int "Sample rate (Hz)"
            default 44100
    endmenu

endmenu
```

## backend/sdkconfig.defaults
```kconfig
# ESP32-LyraT v4.3 standaardconfiguratie

#
# FreeRTOS
#
CONFIG_FREERTOS_HZ=1000
CONFIG_FREERTOS_ENABLE_BACKWARD_COMPATIBILITY=y

#
# SPI RAM config
#
CONFIG_SPIRAM_BOOT_INIT=y
CONFIG_SPIRAM_USE_MALLOC=y
CONFIG_SPIRAM_IGNORE_NOTFOUND=y
CONFIG_SPIRAM_ALLOW_STACK_EXTERNAL_MEMORY=y
CONFIG_SPIRAM_ALLOW_BSS_SEG_EXTERNAL_MEMORY=y
CONFIG_SPIRAM_TRY_ALLOCATE_WIFI_LWIP=y

# Increase default app partition size to accommodate SPIRAM
# by providing new partition table in "partitions_http_select_decoder_example.csv"
CONFIG_PARTITION_TABLE_CUSTOM=y
CONFIG_PARTITION_TABLE_CUSTOM_FILENAME="partitions_http_select_decoder_example.csv"

CONFIG_ESP_TLS_INSECURE=y
CONFIG_ESP_TLS_SKIP_SERVER_CERT_VERIFY=y
CONFIG_ESP_SYSTEM_EVENT_TASK_STACK_SIZE=3072

#
# Wi-Fi
#
CONFIG_ESP_WIFI_SOFTAP_SUPPORT=y
CONFIG_ESP32_WIFI_STATIC_RX_BUFFER_NUM=16
CONFIG_ESP32_WIFI_DYNAMIC_RX_BUFFER_NUM=64
CONFIG_ESP32_WIFI_DYNAMIC_TX_BUFFER_NUM=64
CONFIG_ESP32_WIFI_AMPDU_TX_ENABLED=y
CONFIG_ESP32_WIFI_TX_BA_WIN=32
CONFIG_ESP32_WIFI_AMPDU_RX_ENABLED=y
CONFIG_ESP32_WIFI_RX_BA_WIN=32

#
# LWIP
#
CONFIG_LWIP_TCP_SND_BUF_DEFAULT=65534
CONFIG_LWIP_TCP_WND_DEFAULT=65534
CONFIG_LWIP_TCP_RECVMBOX_SIZE=64
CONFIG_LWIP_UDP_RECVMBOX_SIZE=64
CONFIG_LWIP_TCPIP_RECVMBOX_SIZE=64

CONFIG_ESP_TLS_INSECURE=y
CONFIG_ESP_TLS_SKIP_SERVER_CERT_VERIFY=y
CONFIG_ESP_SYSTEM_EVENT_TASK_STACK_SIZE=3072

# Geheugen: voldoende heap voor audio streaming
CONFIG_ESP_MAIN_TASK_STACK_SIZE=8192
CONFIG_FREERTOS_IDLE_TASK_STACKSIZE=1536

# I2S
CONFIG_I2S_ISR_IRAM_SAFE=y

# HTTP Client (voor audio streaming)
CONFIG_ESP_HTTP_CLIENT_ENABLE_HTTPS=y

# Tijdsynchronisatie
CONFIG_LWIP_SNTP_MAX_SERVERS=2

# Logging
CONFIG_LOG_DEFAULT_LEVEL_INFO=y

# Audio buffer
CONFIG_SPIRAM=n

# Partitietabel: custom voor 2MB flash (1.75MB app)
CONFIG_PARTITION_TABLE_CUSTOM=y
CONFIG_PARTITION_TABLE_CUSTOM_FILENAME="partitions.csv"

# esp_audio_codec: alleen MP3 en AAC nodig voor internetradio
CONFIG_AUDIO_DECODER_MP3_SUPPORT=y
CONFIG_AUDIO_DECODER_AAC_SUPPORT=y
CONFIG_AUDIO_DECODER_G711_SUPPORT=n
CONFIG_AUDIO_DECODER_AMRNB_SUPPORT=n
CONFIG_AUDIO_DECODER_AMRWB_SUPPORT=n
CONFIG_AUDIO_DECODER_FLAC_SUPPORT=n
CONFIG_AUDIO_DECODER_OPUS_SUPPORT=n
CONFIG_AUDIO_DECODER_VORBIS_SUPPORT=n
CONFIG_AUDIO_DECODER_ADPCM_SUPPORT=n
CONFIG_AUDIO_DECODER_ALAC_SUPPORT=n
CONFIG_AUDIO_DECODER_PCM_SUPPORT=n
CONFIG_AUDIO_DECODER_SBC_SUPPORT=n
CONFIG_AUDIO_DECODER_LC3_SUPPORT=n

# Alle encoders uit (niet nodig voor radio)
CONFIG_AUDIO_ENCODER_AAC_SUPPORT=n
CONFIG_AUDIO_ENCODER_G711_SUPPORT=n
CONFIG_AUDIO_ENCODER_AMRNB_SUPPORT=n
CONFIG_AUDIO_ENCODER_AMRWB_SUPPORT=n
CONFIG_AUDIO_ENCODER_OPUS_SUPPORT=n
CONFIG_AUDIO_ENCODER_ADPCM_SUPPORT=n
CONFIG_AUDIO_ENCODER_ALAC_SUPPORT=n
CONFIG_AUDIO_ENCODER_PCM_SUPPORT=n
CONFIG_AUDIO_ENCODER_SBC_SUPPORT=n
CONFIG_AUDIO_ENCODER_LC3_SUPPORT=n
```

## frontend/main/Kconfig.projbuild
```kconfig
menu "Wekker-Radio Configuratie"

    menu "UART Besturing"
        config LYRAT_UART_BAUDRATE
            int "Baudrate"
            default 460800
            help
                Baudrate voor UART2 communicatie met de backend (LyraT).
                Beide apparaten moeten dezelfde waarde gebruiken.

        config LYRAT_UART_TX_PIN
            int "UART TX GPIO (Waveshare → LyraT RX)"
            default 15
            help
                GPIO waarop de Waveshare commando's verstuurt naar de LyraT.

        config LYRAT_UART_RX_PIN
            int "UART RX GPIO (LyraT TX → Waveshare)"
            default 16
            help
                GPIO waarop de Waveshare antwoorden ontvangt van de LyraT.
    endmenu

    menu "Audio"
        config DEFAULT_VOLUME
            int "Standaard volume bij opstarten (0-100)"
            default 10
            range 0 100
            help
                Volume dat bij het opstarten naar de LyraT wordt gestuurd.
    endmenu

    menu "Display"
        config DEFAULT_BRIGHTNESS
            int "Standaard helderheid bij opstarten (0-100)"
            default 80
            range 0 100
            help
                Helderheid van de LCD-backlight bij opstarten (PWM percentage).
    endmenu

endmenu
```
